## boards/shields/cirquei2ctest/Kconfig.defconfig
```kconfig
if SHIELD_CIRQUEI2CTEST

# Name must be less than 16 characters long!
config ZMK_KEYBOARD_NAME
    default "cirquei2ctest"

config ZMK_POINTING
    default y

config I2C
    default y if $(success,test -n "$(CONFIG_I2C)")
    # This tells Kconfig: "If I2C is already being handled by the board/PMIC, don't create a new dependency loop."

endif
```

## config/west.yml
```yaml
manifest:
  remotes:
    - name: zmkfirmware
      url-base: https://github.com/zmkfirmware
    - name: felixJR123
      url-base: https://github.com/felixJR123
  projects:
    - name: zmk
      remote: zmkfirmware
      revision: main
      import: app/west.yml
    - name: cirque-input-module
      remote: felixJR123
      revision: main
  self:
    path: config
```
