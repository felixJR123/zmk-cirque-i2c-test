#include <behaviors.dtsi>
#include <dt-bindings/zmk/keys.h>

/ {
    keymap {
        compatible = "zmk,keymap";

        default_layer {
            display-name = "Base";
            bindings = <
                &kp A
            >;
        };
        default_layer_1 {
            display-name = "Layer1";
            bindings = <
                &none
            >;
        };
    };
};
